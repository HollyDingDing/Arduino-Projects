/* Sketch was generated by motoblockly 
 Website: http://www.motoblockly.com 
 Author: www.motoduino.com 
 Date: Fri Nov 13 2020 13:39:46 GMT+0800
 */


#include "motoWiFiEsp.h"
#include <motoDHT.h>
DHT motoDHT(2, DHT22);

#include <SoftwareSerial.h>

#include <Wire.h>
#include <motoLiquidCrystal_I2C.h>

SoftwareSerial esp8266_Serial(13,12);

WiFiEspClient esp_client;

int connect_status = WL_IDLE_STATUS;

LiquidCrystal_I2C mylcd(0x27,16,2);

String ipAddressToString(const IPAddress& ipAddress ) {
       return String(ipAddress[0]) + String(".")+
       String(ipAddress[1]) + String(".")+
       String(ipAddress[2]) + String(".")+
       String(ipAddress[3]);
}
 
void setup()
{
  pinMode(2,INPUT);
  digitalWrite(2,HIGH);
  Serial.begin(9600);
  esp8266_Serial.begin(9600);
  motoDHT.begin();
  

    esp8266_Serial.listen();
  WiFi.init(&esp8266_Serial); 
  if(WiFi.status()==WL_NO_SHIELD) {
   Serial.println(F("Esp8266 module no present"));
   while(true);
   }
  while(connect_status != WL_CONNECTED) {
   Serial.println(F("Connect to router..."));
   connect_status = WiFi.begin("Roger","artw5619");
  }
  
  Serial.print(String("IP:") + String(ipAddressToString(WiFi.localIP())));

}

int settemp=6;
void loop(){
  
  while(settemp+15>=0||settemp-29<=0){
    float t=motoDHT.readTemperature();
    float moisture=motoDHT.readHumidity();
    Serial.println(String(t)+String("℃")+String(moisture)+String("％"));
    if(t-settemp>1.5&&settemp-t<0){
      digitalWrite(9,LOW);//接常開
    }
    else{
      digitalWrite(9,HIGH);
    }

    esp8266_Serial.listen();
  if (esp_client.connectSSL("notify-api.line.me",443)) {
       String data = "message="+String(t)+String("℃")+String(moisture)+String("％");
       esp_client.println("POST /api/notify HTTP/1.1");
       esp_client.println("Host: notify-api.line.me");
       esp_client.println("Authorization: Bearer KFEHa2duS6tHFIqnwKjgBXv7w02EZd8FpvuQncpygfX");
       esp_client.println("Content-Type: application/x-www-form-urlencoded");
       esp_client.print("Content-Length: ");
       esp_client.println(data.length());
       esp_client.println();
       esp_client.println(data);
       esp_client.stop();
  }
    
    
    delay(200);

    
    }

     
  
}
